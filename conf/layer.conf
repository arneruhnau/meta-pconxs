## conf/layer.conf
```bitbake
BBPATH .= ":${LAYERDIR}"

BBFILES += "${LAYERDIR}/recipes-*/*/*.bb \
            ${LAYERDIR}/recipes-*/*/*.bbappend"

BBFILE_COLLECTIONS += "pconxs"
BBFILE_PATTERN_pconxs = "^${LAYERDIR}"
BBFILE_PRIORITY_pconxs = "5"
LAYERVERSION_pconxs = "1"
```

## conf/machine/imx6dltrizeps7pconxs.conf
```bitbake
#@TYPE: Machine
#@NAME: K&K i.MX6DL Trizeps 7 pConXS
#@SOC: i.MX6DL
#@DESCRIPTION: Machine configuration for K&K i.MX6DL Trizeps 7 pConXS
#@MAINTAINER: Arne Ruhnau <arne.ruhnau@target-sg.com>

require conf/machine/include/imx-base.inc
require conf/machine/include/tune-cortexa9.inc

PREFERRED_PROVIDER_virtual/kernel = "linux-stable"
#PREFERRED_PROVIDER_virtual/kernel = "linux-fslc"
PREFERRED_PROVIDER_virtual/bootloader = "u-boot-fslc"

SERIAL_CONSOLE = "115200 ttymxc1"
SOC_FAMILY = "mx6:mx6dl"

KERNEL_IMAGETYPE = "uImage"
KERNEL_DEVICETREE = "imx6dl-trizeps7-pconxs.dtb"

UBOOT_CONFIG = "sd"
UBOOT_CONFIG[sd] = "mx6dltrizeps7pconxs_config,sdcard"

MACHINE_FEATURES = "apm usbgadget usbhost vfat"
```
